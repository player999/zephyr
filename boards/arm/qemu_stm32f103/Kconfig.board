## boards/arm/qemu_stm32f103/Kconfig.board
```kconfig
config BOARD_QEMU_STM32F103
	bool "STM32F103 generic model for QEMU"
	depends on SOC_STM32F103XB
```

## boards/arm/qemu_stm32f103/Kconfig.defconfig
```kconfig
if BOARD_QEMU_STM32F103

config BOARD
	default "qemu_stm32f103"

endif # BOARD_QEMU_STM32F103
```
